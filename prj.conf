## prj.conf
```kconfig
#
# Copyright (c) 2018 Nordic Semiconductor
#
# SPDX-License-Identifier: LicenseRef-Nordic-5-Clause
#
CONFIG_NCS_SAMPLES_DEFAULTS=y

CONFIG_SHELL=y

CONFIG_BT_DEVICE_NAME="Nordic_Throughput"
CONFIG_BT=y
CONFIG_BT_DEBUG_LOG=y
CONFIG_BT_SMP=y
CONFIG_BT_PERIPHERAL=y
CONFIG_BT_CENTRAL=y
CONFIG_BT_MAX_CONN=2

# BT_LL_SW_SPLIT=y
# CONFIG_BT_CTLR_ADVANCED_FEATURES=y
CONFIG_BT_CTLR_TX_PWR_DYNAMIC_CONTROL=y

CONFIG_BT_SCAN=y
CONFIG_BT_SCAN_FILTER_ENABLE=y
CONFIG_BT_SCAN_UUID_CNT=1

CONFIG_BT_GATT_CLIENT=y
CONFIG_BT_THROUGHPUT=n

CONFIG_BT_GATT_DM=y
CONFIG_HEAP_MEM_POOL_SIZE=2048

CONFIG_BT_USER_DATA_LEN_UPDATE=y
CONFIG_BT_USER_PHY_UPDATE=y
CONFIG_BT_GAP_AUTO_UPDATE_CONN_PARAMS=n

CONFIG_BT_BUF_ACL_RX_SIZE=517
CONFIG_BT_BUF_ACL_RX_COUNT=8
CONFIG_BT_BUF_EVT_RX_COUNT=8

CONFIG_BT_ATT_PREPARE_COUNT=7
CONFIG_BT_L2CAP_TX_BUF_COUNT=10
CONFIG_BT_L2CAP_TX_MTU=512
CONFIG_BT_L2CAP_DYNAMIC_CHANNEL=y
CONFIG_BT_CONN_TX_MAX=10
CONFIG_BT_BUF_ACL_TX_COUNT=10
CONFIG_BT_BUF_ACL_TX_SIZE=517


CONFIG_BT_CTLR_DATA_LENGTH_MAX=251
CONFIG_BT_CTLR_PHY_2M=y
CONFIG_BT_CTLR_RX_BUFFERS=2
CONFIG_BT_CTLR_SDC_MAX_CONN_EVENT_LEN_DEFAULT=4000000

CONFIG_DK_LIBRARY=y
CONFIG_DK_LIBRARY_DYNAMIC_BUTTON_HANDLERS=y
```

## src/cmds.c
```c
/*
 * Copyright (c) 2020 Nordic Semiconductor ASA
 *
 * SPDX-License-Identifier: LicenseRef-Nordic-5-Clause
 */

#include <stdlib.h>

#include <zephyr/bluetooth/conn.h>

#include <errno.h>
#include <zephyr/shell/shell.h>
#include <zephyr/types.h>

#define INTERVAL_MIN 0x00c /* 320 units, 400 ms */
#define INTERVAL_MAX 0x00c /* 320 units, 400 ms */
#define CONN_LATENCY 0

#define MIN_CONN_INTERVAL   6
#define MAX_CONN_INTERVAL   3200
#define SUPERVISION_TIMEOUT 100

static struct test_params {
	struct bt_le_conn_param *conn_param;
	struct bt_conn_le_phy_param *phy;
	struct bt_conn_le_data_len_param *data_len;
} test_params = {
	.conn_param = 
    BT_LE_CONN_PARAM(
      INTERVAL_MIN, 
      INTERVAL_MAX, 
      CONN_LATENCY,
			SUPERVISION_TIMEOUT),
	.phy = BT_CONN_LE_PHY_PARAM_2M,
	.data_len = BT_LE_DATA_LEN_PARAM_MAX
};

extern int test_run(
  const struct shell *shell,
  const struct bt_le_conn_param *conn_param,
  const struct bt_conn_le_phy_param *phy,
  const struct bt_conn_le_data_len_param *data_len
);

static const char *phy_str(const struct bt_conn_le_phy_param *phy)
{
	static const char *const str[] = {
		"1 Mbps",
		"2 Mbps",
		"Coded S2",
		"Coded S8",
		"Unknown"
	};

	switch (phy->pref_tx_phy) {
	case BT_GAP_LE_PHY_1M:
		return str[0];

	case BT_GAP_LE_PHY_2M:
		return str[1];

	case BT_GAP_LE_PHY_CODED:
		if (phy->options == BT_CONN_LE_PHY_OPT_CODED_S2) {
			return str[2];
		} else if (phy->options == BT_CONN_LE_PHY_OPT_CODED_S8) {
			return str[3];
		}

	default:
		return str[4];
	}
}

static int default_cmd(
  const struct shell *shell, 
  size_t argc,
  char **argv
){
	if (argc == 1) {
		shell_help(shell);
		return SHELL_CMD_HELP_PRINTED;
	}

	if (argc > 2) {
		shell_error(shell, "%s: bad parameters count.", argv[0]);
		return -EINVAL;
	}

	if (argc == 2) {
		shell_error(shell, "Uknown argument: %s", argv[1]);
		return -EINVAL;
	}

	return 0;
}

static int cmd_phy_1m(
  const struct shell *shell, 
  size_t argc,
	char **argv
){
	test_params.phy->options = BT_CONN_LE_PHY_OPT_NONE;
	test_params.phy->pref_rx_phy = BT_GAP_LE_PHY_1M;
	test_params.phy->pref_tx_phy = BT_GAP_LE_PHY_1M;

	shell_print(shell, "PHY set to: %s", phy_str(test_params.phy));

	return 0;
}

static int cmd_phy_2m(const struct shell *shell, size_t argc,
		      char **argv)
{
	test_params.phy->options = BT_CONN_LE_PHY_OPT_NONE;
	test_params.phy->pref_rx_phy = BT_GAP_LE_PHY_2M;
	test_params.phy->pref_tx_phy = BT_GAP_LE_PHY_2M;

	shell_print(shell, "PHY set to: %s", phy_str(test_params.phy));

	return 0;
}

#if defined(RADIO_MODE_MODE_Ble_LR500Kbit) || defined(NRF5340_XXAA_APPLICATION)
static int cmd_phy_coded_s2(const struct shell *shell, size_t argc,
			    char **argv)
{
	test_params.phy->options = BT_CONN_LE_PHY_OPT_CODED_S2;
	test_params.phy->pref_rx_phy = BT_GAP_LE_PHY_CODED;
	test_params.phy->pref_tx_phy = BT_GAP_LE_PHY_CODED;

	shell_print(shell, "PHY set to: %s", phy_str(test_params.phy));

	return 0;
}
#endif /* defined(RADIO_MODE_MODE_Ble_LR1500Kbit) ||
	* defined(NRF5340_XXAA_APPLICATION)
	*/

#if defined(RADIO_MODE_MODE_Ble_LR125Kbit) || defined(NRF5340_XXAA_APPLICATION)
static int cmd_phy_coded_s8(const struct shell *shell, size_t argc,
			    char **argv)
{
	test_params.phy->options = BT_CONN_LE_PHY_OPT_CODED_S8;
	test_params.phy->pref_rx_phy = BT_GAP_LE_PHY_CODED;
	test_params.phy->pref_tx_phy = BT_GAP_LE_PHY_CODED;

	shell_print(shell, "PHY set to: %s",
		    phy_str(test_params.phy));

	return 0;
}
#endif /* defined(RADIO_MODE_MODE_Ble_LR125Kbit) ||
	* defined(NRF5340_XXAA_APPLICATION)
	*/

static int data_len_cmd(const struct shell *shell, size_t argc,
			char **argv)
{
	uint16_t data_len;

	if (argc == 1) {
		shell_help(shell);
		return SHELL_CMD_HELP_PRINTED;
	}

	if (argc > 2) {
		shell_error(shell, "%s: bad parameters count", argv[0]);
		return -EINVAL;
	}

	data_len = strtol(argv[1], NULL, 10);

	if ((data_len < BT_GAP_DATA_LEN_DEFAULT) ||
	    (data_len > BT_GAP_DATA_LEN_MAX)) {
		shell_error(shell, "%s: Invalid setting: %d", argv[0],
			    data_len);
		shell_error(shell,
			    "LE Data Packet Length must be between: %d and %d",
			    BT_GAP_DATA_LEN_DEFAULT, BT_GAP_DATA_LEN_MAX);
		return -EINVAL;
	}

	test_params.data_len->tx_max_len = data_len;
	test_params.data_len->tx_max_time = BT_GAP_DATA_TIME_MAX;

	shell_print(shell, "LE Data Packet Length set to: %d", data_len);

	return 0;
}

static int conn_interval_cmd(const struct shell *shell, size_t argc,
			     char **argv)
{
	uint16_t interval;

	if (argc == 1) {
		shell_help(shell);
		return SHELL_CMD_HELP_PRINTED;
	}

	if (argc > 2) {
		shell_error(shell, "%s: bad parameters count", argv[0]);
		return -EINVAL;
	}

	interval = strtol(argv[1], NULL, 10);

	if ((interval < MIN_CONN_INTERVAL) ||
	    (interval > MAX_CONN_INTERVAL)) {
		shell_error(shell, "%s: Invalid setting: %d", argv[0],
			    interval);
		shell_error(shell,
			    "Connection interval must be between: %d and %d",
			    MIN_CONN_INTERVAL, MAX_CONN_INTERVAL);
		return -EINVAL;
	}

	test_params.conn_param->interval_max = interval;
	test_params.conn_param->interval_min = interval;
	test_params.conn_param->latency = 0;
	test_params.conn_param->timeout = SUPERVISION_TIMEOUT;

	shell_print(shell, "Connection interval set to: %d",
		    interval);

	return 0;
}

static int print_cmd(
  const struct shell *shell, 
  size_t argc,
	char **argv
){
	shell_print(shell, "==== Current test configuration ====\n");
	shell_print(shell, "Data length:\t\t%d\n"
		    "Connection interval:\t%d units\n"
		    "Preferred PHY:\t\t%s\n",
		    test_params.data_len->tx_max_len,
		    test_params.conn_param->interval_min,
		    phy_str(test_params.phy));
	return 0;
}

SHELL_STATIC_SUBCMD_SET_CREATE(phy_sub,
	SHELL_CMD(1M, NULL, "Set preferred PHY to 1Mbps", cmd_phy_1m),
	SHELL_CMD(2M, NULL, "Set preferred PHY to 2Mbps", cmd_phy_2m),
#if defined(RADIO_MODE_MODE_Ble_LR500Kbit) || defined(NRF5340_XXAA_APPLICATION)
	SHELL_CMD(coded_s2, NULL, "Set preferred PHY to Coded S2",
		  cmd_phy_coded_s2),
#endif
#if defined(RADIO_MODE_MODE_Ble_LR125Kbit) || defined(NRF5340_XXAA_APPLICATION)
	SHELL_CMD(coded_s8, NULL, "Set preferred PHY to Coded S8",
		  cmd_phy_coded_s8),
#endif
	SHELL_SUBCMD_SET_END
);

SHELL_STATIC_SUBCMD_SET_CREATE(sub_config,
	SHELL_CMD(data_length, NULL, "Configure data length", data_len_cmd),
	SHELL_CMD(conn_interval, NULL,
		  "Configure connection interval <1.25ms units>",
		  conn_interval_cmd),
	SHELL_CMD(phy, &phy_sub, "Configure connection interval", default_cmd),
	SHELL_CMD(print, NULL, "Print current configuration", print_cmd),
	SHELL_SUBCMD_SET_END
);


static int test_run_cmd(
  const struct shell *shell, 
  size_t argc,
	char **argv
){
	return 
    test_run(
      shell, 
      test_params.conn_param, 
      test_params.phy,
			test_params.data_len);
}

SHELL_CMD_REGISTER(config, &sub_config, "Configure the example", default_cmd);
SHELL_CMD_REGISTER(run, NULL, "Run the test", test_run_cmd);
```

## src/throughput_demo.c
```c
/*
 * Copyright (c) 2018 Nordic Semiconductor ASA
 *
 * SPDX-License-Identifier: LicenseRef-Nordic-5-Clause
 */

#include <zephyr/kernel.h>
#include <zephyr/sys/printk.h>
#include <string.h>
#include <zephyr/types.h>
#include <zephyr/bluetooth/bluetooth.h>
#include <zephyr/bluetooth/conn.h>
#include <zephyr/bluetooth/gatt.h>
#include <zephyr/bluetooth/hci.h>
#include <zephyr/bluetooth/uuid.h>
#include "throughput_demo.h"

#include <zephyr/logging/log.h>

LOG_MODULE_REGISTER(bt_throughput, 3);

static K_SEM_DEFINE(indicate_sem, 0, 1);

static bool notifications_enabled = false;
static bool indications_enabled = false;
static struct bt_throughput_metrics met;
static const struct bt_throughput_cb *callbacks;

static uint8_t read_fn(
  struct bt_conn *conn, 
  uint8_t err,
	struct bt_gatt_read_params *params, 
  const void *data,
	uint16_t len
){
	struct bt_throughput_metrics metrics;

	memset(&metrics, 0, sizeof(struct bt_throughput_metrics));

	if (data) {
		len = MIN(len, sizeof(struct bt_throughput_metrics));
		memcpy(&metrics, data, len);

		if (callbacks && callbacks->data_read) {
			return callbacks->data_read(&metrics);
		}
	}

	return BT_GATT_ITER_STOP;
}

static ssize_t config_write_callback(
  struct bt_conn *conn,
	const struct bt_gatt_attr *attr, 
  const void *buf,
	uint16_t len, 
  uint16_t offset, 
  uint8_t flags
){
  const uint8_t *write_data = buf;

  switch (write_data[0]){
    case 0: 
      LOG_INF("Throughtput mode change %d", write_data[1]);
      switch (write_data[1])
      {
      case NOTIFICATION:
        if (callbacks && callbacks->mode_change) {
          callbacks->mode_change(NOTIFICATION);
        }
        break;
      case INDICATION:
        if (callbacks && callbacks->mode_change) {
          callbacks->mode_change(INDICATION);
        }
        break;
      case WRITE:
        if (callbacks && callbacks->mode_change) {
          callbacks->mode_change(WRITE);
        }
        break;
      case WRITE_WITHOUT_RESPONSE:
        if (callbacks && callbacks->mode_change) {
          callbacks->mode_change(WRITE_WITHOUT_RESPONSE);
        }
        break;
      default:
        break;
      }
      break;
    case 1:
      LOG_INF("Undefined");
      break;
  }
}

static ssize_t control_write_callback(
  struct bt_conn *conn,
	const struct bt_gatt_attr *attr, 
  const void *buf,
	uint16_t len, 
  uint16_t offset, 
  uint8_t flags
){

  const uint8_t *write_data = buf;
  switch (write_data[0]){
    case 0: 
      LOG_INF("Throughtput mode change %d", write_data[1]);
      switch (write_data[1])
      {
      case START:
        if (callbacks && callbacks->command_received) {
          callbacks->command_received(START);
        }
        break;
      case STOP:
        if (callbacks && callbacks->command_received) {
          callbacks->command_received(STOP);
        }
        break;
      case RESET:
        if (callbacks && callbacks->command_received) {
          callbacks->command_received(RESET);
        }
        break;
      default:
        break;
      }
      break;
    case 1:
      LOG_INF("Undefined");
      break;
  }
  
}

static ssize_t write_callback(
  struct bt_conn *conn,
	const struct bt_gatt_attr *attr, 
  const void *buf,
	uint16_t len, 
  uint16_t offset, 
  uint8_t flags
){
	static uint32_t clock_cycles;
	static uint32_t kb;

	uint64_t delta;

	struct bt_throughput_metrics *met_data = attr->user_data;

	delta = k_cycle_get_32() - clock_cycles;
	delta = k_cyc_to_ns_floor64(delta);

	if (len == 1) {
		/* reset metrics */
		kb = 0;
		met_data->write_count = 0;
		met_data->write_len = 0;
		met_data->write_rate = 0;
		clock_cycles = k_cycle_get_32();
	} else {
		met_data->write_count++;
		met_data->write_len += len;
		met_data->write_rate =
		    ((uint64_t)met_data->write_len << 3) * 1000000000 / delta;
	}

	LOG_INF("Received data. %u", (delta));

	if (callbacks && callbacks->data_received) {
		callbacks->data_received(met_data);
	}

	return len;
}

static ssize_t read_callback(
  struct bt_conn *conn,
	const struct bt_gatt_attr *attr, 
  void *buf,
	uint16_t len, 
  uint16_t offset
){
	const struct bt_throughput_metrics *metrics = attr->user_data;

	len = MIN(sizeof(struct bt_throughput_metrics), len);

	if (callbacks && callbacks->data_send) {
		callbacks->data_send(metrics);
	}

	LOG_DBG("Data send.");

	return bt_gatt_attr_read(
		conn, attr, buf, len, offset, attr->user_data, len);
}

static void _throughput_ccc_cfg_changed(const struct bt_gatt_attr *attr, uint16_t value)
{
  /* a dummy data buffer */
	static char dummy[495];
	ARG_UNUSED(attr);
  notifications_enabled = (value == BT_GATT_CCC_NOTIFY);
	LOG_INF("Notification %s", notifications_enabled ? "enabled" : "disabled");
}

static void _throughput_cccd_cfg_changed(const struct bt_gatt_attr *attr, uint16_t value)
{
  /* a dummy data buffer */
	static char dummy[495];
	ARG_UNUSED(attr);
  indications_enabled = (value == BT_GATT_CCC_INDICATE);
	LOG_INF("Indications %s", indications_enabled ? "enabled" : "disabled");
}

BT_GATT_SERVICE_DEFINE(throughput_svc,
BT_GATT_PRIMARY_SERVICE(BT_UUID_THROUGHPUT),
	BT_GATT_CHARACTERISTIC(BT_UUID_THROUGHPUT_CHAR_N,
		BT_GATT_CHRC_READ | BT_GATT_CHRC_WRITE | BT_GATT_CHRC_WRITE_WITHOUT_RESP | BT_GATT_CHRC_NOTIFY,
		BT_GATT_PERM_READ | BT_GATT_PERM_WRITE,
		read_callback, 
    write_callback, 
    &met),
  BT_GATT_CCC(_throughput_ccc_cfg_changed, BT_GATT_PERM_READ | BT_GATT_PERM_WRITE),
  BT_GATT_CHARACTERISTIC(BT_UUID_THROUGHPUT_CHAR_I,
		BT_GATT_CHRC_READ | BT_GATT_CHRC_WRITE | BT_GATT_CHRC_WRITE_WITHOUT_RESP | BT_GATT_CHRC_INDICATE,
		BT_GATT_PERM_READ | BT_GATT_PERM_WRITE,
		read_callback, 
    write_callback, 
    &met),
  BT_GATT_CCC(_throughput_cccd_cfg_changed, BT_GATT_PERM_READ | BT_GATT_PERM_WRITE),
  BT_GATT_CHARACTERISTIC(BT_UUID_THROUGHPUT_CHAR_CONFIG,
		BT_GATT_CHRC_WRITE ,
		BT_GATT_PERM_WRITE,
		NULL, 
    config_write_callback, 
    &met),
  BT_GATT_CHARACTERISTIC(BT_UUID_THROUGHPUT_CHAR_CONTROL,
		BT_GATT_CHRC_WRITE ,
		BT_GATT_PERM_WRITE,
		NULL, 
    control_write_callback, 
    &met),
);
enum {
    HIDS_REMOTE_WAKE = BIT(0),
    HIDS_NORMALLY_CONNECTABLE = BIT(1),
};

struct hids_info {
    uint16_t version; /* version number of base USB HID Specification */
    uint8_t code;     /* country HID Device hardware is localized for. */
    uint8_t flags;
} __packed;

struct hids_report {
    uint8_t id;   /* report id */
    uint8_t type; /* report type */
} __packed;

static struct hids_info info = {
    .version = 0x0000,
    .code = 0x00,
    .flags = HIDS_NORMALLY_CONNECTABLE,
};

enum {
    HIDS_INPUT = 0x01,
    HIDS_OUTPUT = 0x02,
    HIDS_FEATURE = 0x03,
};

static struct hids_report input = {
    .id = 0x01,
    .type = HIDS_INPUT,
};
static uint8_t simulate_input;
static uint8_t ctrl_point;
static uint8_t report_map[] = {
    0x05, 0x01, /* Usage Page (Generic Desktop Ctrls) */
    0x09, 0x02, /* Usage (Mouse) */
    0xA1, 0x01, /* Collection (Application) */
    0x09, 0x01, /*   Usage (Pointer) */
    0xA1, 0x00, /*   Collection (Physical) */
    0x05, 0x09, /*     Usage Page (Button) */
    0x19, 0x01, /*     Usage Minimum (0x01) */
    0x29, 0x03, /*     Usage Maximum (0x03) */
    0x15, 0x00, /*     Logical Minimum (0) */
    0x25, 0x01, /*     Logical Maximum (1) */
    0x95, 0x03, /*     Report Count (3) */
    0x75, 0x01, /*     Report Size (1) */
    0x81, 0x02, /*     Input (Data,Var,Abs,No Wrap,Linear,...) */
    0x95, 0x01, /*     Report Count (1) */
    0x75, 0x05, /*     Report Size (5) */
    0x81, 0x03, /*     Input (Const,Var,Abs,No Wrap,Linear,...) */
    0x05, 0x01, /*     Usage Page (Generic Desktop Ctrls) */
    0x09, 0x30, /*     Usage (X) */
    0x09, 0x31, /*     Usage (Y) */
    0x15, 0x81, /*     Logical Minimum (129) */
    0x25, 0x7F, /*     Logical Maximum (127) */
    0x75, 0x08, /*     Report Size (8) */
    0x95, 0x02, /*     Report Count (2) */
    0x81, 0x06, /*     Input (Data,Var,Rel,No Wrap,Linear,...) */
    0xC0,       /*   End Collection */
    0xC0,       /* End Collection */
};


static ssize_t read_info(struct bt_conn *conn,
                         const struct bt_gatt_attr *attr, void *buf,
                         uint16_t len, uint16_t offset)
{
    return 0;
}

static ssize_t read_report_map(struct bt_conn *conn,
                               const struct bt_gatt_attr *attr, void *buf,
                               uint16_t len, uint16_t offset)
{
    return 0;
}

static ssize_t read_report(struct bt_conn *conn,
                           const struct bt_gatt_attr *attr, void *buf,
                           uint16_t len, uint16_t offset)
{
    return 0;
}

static void input_ccc_changed(const struct bt_gatt_attr *attr, uint16_t value)
{

}

static ssize_t read_input_report(struct bt_conn *conn,
                                 const struct bt_gatt_attr *attr, void *buf,
                                 uint16_t len, uint16_t offset)
{
    return 0;
}

static ssize_t write_ctrl_point(struct bt_conn *conn,
                                const struct bt_gatt_attr *attr,
                                const void *buf, uint16_t len, uint16_t offset,
                                uint8_t flags)
{


    return 0;
}

BT_GATT_SERVICE_DEFINE(hid_svc,
    BT_GATT_PRIMARY_SERVICE(BT_UUID_HIDS),
    BT_GATT_CHARACTERISTIC(BT_UUID_HIDS_INFO, BT_GATT_CHRC_READ,
                           BT_GATT_PERM_READ, read_info, NULL, &info),
    BT_GATT_CHARACTERISTIC(BT_UUID_HIDS_REPORT_MAP, BT_GATT_CHRC_READ,
                           BT_GATT_PERM_READ, read_report_map, NULL, NULL),
    BT_GATT_CHARACTERISTIC(BT_UUID_HIDS_REPORT,
                           BT_GATT_CHRC_READ | BT_GATT_CHRC_NOTIFY,
                           BT_GATT_PERM_READ_AUTHEN,
                           read_input_report, NULL, NULL),
    // BT_GATT_CCC(input_ccc_changed,
    //             BT_GATT_PERM_READ_AUTHEN | BT_GATT_PERM_WRITE_AUTHEN),
    // BT_GATT_DESCRIPTOR(BT_UUID_HIDS_REPORT_REF, BT_GATT_PERM_READ,
    //                    read_report, NULL, &input),
    BT_GATT_CHARACTERISTIC(BT_UUID_HIDS_CTRL_POINT,
                           BT_GATT_CHRC_WRITE_WITHOUT_RESP,
                           BT_GATT_PERM_WRITE,
                           NULL, write_ctrl_point, &ctrl_point),
);

int bt_throughput_init(
  struct bt_throughput *throughput,
	const struct bt_throughput_cb *cb
){
	if (!throughput || !cb) {
		return -EINVAL;
	}

	callbacks = cb;

	return 0;
}

int bt_throughput_handles_assign(
  struct bt_gatt_dm *dm,
  struct bt_throughput *throughput
){
	const struct bt_gatt_dm_attr *gatt_service_attr =
			bt_gatt_dm_service_get(dm);
	const struct bt_gatt_service_val *gatt_service =
			bt_gatt_dm_attr_service_val(gatt_service_attr);
	const struct bt_gatt_dm_attr *gatt_chrc;
	const struct bt_gatt_dm_attr *gatt_desc;

	if (bt_uuid_cmp(gatt_service->uuid, BT_UUID_THROUGHPUT)) {
		return -ENOTSUP;
	}

	LOG_DBG("Getting handles from Throughput service.");

	/* Throughput Characteristic. */
	gatt_chrc = bt_gatt_dm_char_by_uuid(dm, BT_UUID_THROUGHPUT_CHAR_N);
	if (!gatt_chrc) {
		LOG_ERR("Missing Throughput characteristic.");
	}

	gatt_desc = bt_gatt_dm_desc_by_uuid(dm, gatt_chrc,
					    BT_UUID_THROUGHPUT_CHAR_N);
	if (!gatt_desc) {
		LOG_ERR("Missing Throughput characteristic value descriptor");
		return -EINVAL;
	}

	LOG_DBG("Found handle for Throughput characteristic.");
	throughput->char_handle = gatt_desc->handle;

	/* Assign connection object. */
	throughput->conn = bt_gatt_dm_conn_get(dm);
	return 0;
}

int bt_throughput_read(struct bt_throughput *throughput)
{
	int err;

	throughput->read_params.single.handle = throughput->char_handle;
	throughput->read_params.single.offset = 0;
	throughput->read_params.handle_count = 1;
	throughput->read_params.func = read_fn;

	err = bt_gatt_read(throughput->conn, &throughput->read_params);

	if (err) {
		LOG_ERR("Characteristic read failed.");
	}

	return err;
}

void send_notification(
  const uint8_t *data, 
  uint16_t len
){
  int result;

  /* Only send the response if notifications have been enbabled */
  if (notifications_enabled){
    result = 
      bt_gatt_notify(
        NULL, 
        &throughput_svc.attrs[2],
        data,
        len);

    if (0 != result){
      LOG_ERR("bt_gatt_notify failed (Error: %d)", result);
      return -1;
    }
  }
}

static void on_indication_complete(struct bt_gatt_indicate_params *params)
{
	k_sem_give(&indicate_sem);
}


struct bt_gatt_indicate_params ind_params;
struct k_sem *send_indication(
  const uint8_t *data, 
  uint16_t len
){
  int result;
  
  ind_params.attr = &throughput_svc.attrs[5];
  ind_params.data = data;
  ind_params.len = len;
  ind_params.func = on_indication_complete;
  
  /* Only send the response if notifications have been enbabled */
  if (notifications_enabled){
    result =
      bt_gatt_indicate(
        NULL,
        &ind_params
      );

    if (0 != result){
      LOG_ERR("bt_gatt_indicate failed (Error: %d)", result);
      return -1;
    }
  }

  return &indicate_sem;
}

int bt_throughput_write(
  struct bt_throughput *throughput,
	const uint8_t *data, 
  uint16_t len
){
	return bt_gatt_write_without_response(
    throughput->conn,
    throughput->char_handle,
    data, len, false);
}
```

## src/throughput_demo.h
```c
/*
 * Copyright (c) 2018 Nordic Semiconductor ASA
 *
 * SPDX-License-Identifier: LicenseRef-Nordic-5-Clause
 */

/**
 * @file
 * @defgroup bt_throughput Bluetooth LE GATT Throughput Service API
 * @{
 * @brief API for the Bluetooth LE GATT Throughput Service.
 */

#ifndef BT_THROUGHPUT_DEMO_H_
#define BT_THROUGHPUT_DEMO_H_

#include <zephyr/bluetooth/uuid.h>
#include <zephyr/bluetooth/conn.h>
#include <bluetooth/gatt_dm.h>

#ifdef __cplusplus
extern "C" {
#endif

typedef enum {
  NOTIFICATION,
  INDICATION,
  WRITE,
  WRITE_WITHOUT_RESPONSE
} throughput_mode_t;

typedef enum {
  START,
  STOP,
  RESET
} throughput_command_t;

/** @brief Throughput metrics. */
struct bt_throughput_metrics {

        /** Number of GATT writes received. */
	uint32_t write_count;

        /** Number of bytes received. */
	uint32_t write_len;

        /** Transfer speed in bits per second. */
	uint32_t write_rate;
};

/** @brief Throughput callback structure. */
struct bt_throughput_cb {
	/** @brief Data read callback.
	 *
	 * This function is called when data has been read from the
	 * Throughput Characteristic.
	 *
	 * @param[in] met Throughput metrics.
	 *
	 * @retval BT_GATT_ITER_CONTINUE To keep notifications enabled.
	 * @retval BT_GATT_ITER_STOP To disable notifications.
	 */
	uint8_t (*data_read)(const struct bt_throughput_metrics *met);

	/** @brief Data received callback.
	 *
	 * This function is called when data has been received by the
	 * Throughput Characteristic.
	 *
	 * @param[in] met Throughput metrics.
	 */
	void (*data_received)(const struct bt_throughput_metrics *met);

	/** @brief Data send callback.
	 *
	 * This function is called when data has been sent to the
	 * Throughput Characteristic.
	 *
	 * @param[in] met Throughput metrics.
	 */
	void (*data_send)(const struct bt_throughput_metrics *met);

  	/** @brief Throughput mode change callback.
	 *
	 * This function is called when data has been sent to the
	 * Throughput Characteristic.
	 *
	 * @param[in] met Throughput metrics.
	 */
	void (*mode_change)(throughput_mode_t mode);

  /** @brief Throughput mode change callback.
	 *
	 * This function is called when data has been sent to the
	 * Throughput Characteristic.
	 *
	 * @param[in] met Throughput metrics.
	 */
	void (*command_received)(throughput_command_t command);
};

/** @brief Throughput structure. */
struct bt_throughput {
	/** Throughput Characteristic handle. */
	uint16_t char_handle;

	/** GATT read parameters for the Throughput Characteristic. */
	struct bt_gatt_read_params read_params;

	/** Throughput callback structure. */
	struct bt_throughput_cb *cb;

	/** Connection object. */
	struct bt_conn *conn;
};

/** @brief Throughput Characteristic UUID. */
#define BT_UUID_THROUGHPUT_CHAR_N BT_UUID_DECLARE_16(0x1524)
#define BT_UUID_THROUGHPUT_CHAR_I BT_UUID_DECLARE_16(0x1525)
#define BT_UUID_THROUGHPUT_CHAR_CONFIG BT_UUID_DECLARE_16(0x1526)
#define BT_UUID_THROUGHPUT_CHAR_CONTROL BT_UUID_DECLARE_16(0x1527)

#define BT_UUID_HID BT_UUID_DECLARE_16(0x1812)
#define BT_UUID_CP BT_UUID_DECLARE_16(0x2a4a)


#define BT_UUID_THROUGHPUT_VAL \
	BT_UUID_128_ENCODE(0x0483dadd, 0x6c9d, 0x6ca9, 0x5d41, 0x03ad4fff4abb)

/** @brief Throughput Service UUID. */
#define BT_UUID_THROUGHPUT                                                     \
	BT_UUID_DECLARE_128(BT_UUID_THROUGHPUT_VAL)

/** @brief Initialize the GATT Throughput Service.
 *
 *  @param[in] throughput Throughput Service instance.
 *  @param[in] cb Callbacks.
 *
 *  @retval 0 If the operation was successful.
 *            Otherwise, a negative error code is returned.
 */
int bt_throughput_init(struct bt_throughput *throughput,
		       const struct bt_throughput_cb *cb);

/** @brief Assign handles to the Throughput Service instance.
 *
 * This function should be called when a link with a peer has been established,
 * to associate the link to this instance of the module. This makes it
 * possible to handle several links and associate each link to a particular
 * instance of this module. The GATT attribute handles are provided by the
 * GATT Discovery Manager.
 *
 * @param[in] dm Discovery object.
 * @param[in,out] throughput Throughput Service instance.
 *
 * @retval 0 If the operation was successful.
 *           Otherwise, a negative error code is returned.
 * @retval (-ENOTSUP) Special error code used when the UUID
 *         of the service does not match the expected UUID.
 */
int bt_throughput_handles_assign(struct bt_gatt_dm *dm,
				 struct bt_throughput *throughput);

/** @brief Read data from the server.
 *
 *  @note This procedure is asynchronous.
 *
 *  @param[in] throughput Throughput Service instance.
 *
 *  @retval 0 If the operation was successful.
 *            Otherwise, a negative error code is returned.
 */
int bt_throughput_read(struct bt_throughput *throughput);

/** @brief Write data to the server.
 *
 *  @param[in] throughput Throughput Service instance.
 *  @param[in] data Data.
 *  @param[in] len Data length.
 *
 *  @retval 0 If the operation was successful.
 *            Otherwise, a negative error code is returned.
 */
int bt_throughput_write(struct bt_throughput *throughput,
			const uint8_t *data, uint16_t len);

void send_notification(
  const uint8_t *data, 
  uint16_t len
);

struct k_sem *send_indication(
  const uint8_t *data, 
  uint16_t len
);

#ifdef __cplusplus
}
#endif

/**
 * @}
 */

#endif /* BT_THROUGHPUT_H_ */
```
